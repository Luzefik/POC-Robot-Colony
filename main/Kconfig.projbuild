## main/Kconfig.projbuild
```kconfig
menu "UGV column configuration"

    config UGV_MODE_SWITCH_GPIO
        int "Leader/Follower mode switch GPIO (SW1), -1 to disable"
        range -1 39
        default -1
        help
            GPIO of the SW1 mode switch, read once at boot with an internal
            pull-up: level 1 selects LEADER mode (Bluetooth gamepad), level 0
            selects FOLLOWER mode (vision tracking). Set to -1 when the board
            has no switch; the DEFAULT_ROLE_LEADER define at the top of
            main/main.c is used instead.

    config UGV_ENABLE_WEB_STREAM
        bool "Enable Wi-Fi MJPEG debug stream"
        default n
        help
            Starts Wi-Fi (station) and an HTTP server that streams the
            camera as MJPEG on port 80. Useful to tune the detection, adds
            latency to the vision pipeline - keep off during normal runs.

    config UGV_WIFI_SSID
        string "Wi-Fi SSID for the debug stream"
        default ""

    config UGV_WIFI_PASSWORD
        string "Wi-Fi password for the debug stream"
        default ""

    config UGV_ESPNOW_CHANNEL
        int "Column link anchor Wi-Fi channel (1-13)"
        range 1 13
        default 1
        help
            Channel used by robots that are NOT connected to a hotspot.
            Senders (leader) anchor here; followers auto-scan all channels
            until they hear column traffic, so this rarely needs changing.
            When a robot joins a hotspot (debug stream), the AP's channel
            is used instead.

    config UGV_HOSTNAME
        string "mDNS hostname (empty = auto ugv-XXXX from MAC)"
        default ""
        help
            Stable address of this robot's stream: http://<hostname>.local/
            Leave empty to derive a unique name from the Wi-Fi MAC, e.g.
            ugv-3f7c.local - it never changes for a given board.

endmenu
```
